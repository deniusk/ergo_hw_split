## boards/shields/ergo_hw_split/Kconfig.defconfig
```kconfig
if SHIELD_ERGO_HW_SPLIT_LEFT

config ZMK_KEYBOARD_NAME
    default "Ergo-HW-Split"

config ZMK_SPLIT_ROLE_CENTRAL
    default y

endif

if SHIELD_ERGO_HW_SPLIT_LEFT || SHIELD_ERGO_HW_SPLIT_RIGHT

config ZMK_SPLIT
    default y

endif
```

## boards/shields/ergo_hw_split/Kconfig.shield
```kconfig
config SHIELD_ERGO_HW_SPLIT_LEFT
    def_bool $(shields_list_contains,ergo_hw_split_left)

config SHIELD_ERGO_HW_SPLIT_RIGHT
    def_bool $(shields_list_contains,ergo_hw_split_right)
```
